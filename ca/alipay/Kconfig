## ca/alipay/Kconfig
```kconfig
############################################################################
#
# Copyright (C) 2022-2024 Xiaomi Corporation
#
# Licensed under the Apache License, Version 2.0 (the "License");
# you may not use this file except in compliance with the License.
# You may obtain a copy of the License at
#
#      http://www.apache.org/licenses/LICENSE-2.0
#
# Unless required by applicable law or agreed to in writing, software
# distributed under the License is distributed on an "AS IS" BASIS,
# WITHOUT WARRANTIES OR CONDITIONS OF ANY KIND, either express or implied.
# See the License for the specific language governing permissions and
# limitations under the License.
#
############################################################################

config CA_ALIPAY_API
	bool "use ca alipay api"
	default n
	---help---
		"Use ca alipay api"

if CA_ALIPAY_API

config CA_ALIPAY_TEST
	bool "client application: alipay test"
	default n
	---help---
		"GP CA: ALIPAY_TEST."

if CA_ALIPAY_TEST

config CA_ALIPAY_TEST_PROGNAME
	string "Program name"
	default "ca_alipay_test"
	---help---
		This is the name of the client application that will be used

config CA_ALIPAY_TEST_PRIORITY
	int "alipay test task priority"
	default 100

config CA_ALIPAY_TEST_STACKSIZE
	int "alipay test stack size"
	default 32768

endif
endif
```

## ca/comsst/Kconfig
```kconfig
############################################################################
#
# Copyright (C) 2022-2024 Xiaomi Corporation
#
# Licensed under the Apache License, Version 2.0 (the "License");
# you may not use this file except in compliance with the License.
# You may obtain a copy of the License at
#
#      http://www.apache.org/licenses/LICENSE-2.0
#
# Unless required by applicable law or agreed to in writing, software
# distributed under the License is distributed on an "AS IS" BASIS,
# WITHOUT WARRANTIES OR CONDITIONS OF ANY KIND, either express or implied.
# See the License for the specific language governing permissions and
# limitations under the License.
#
############################################################################

config CA_COMSST_API
	bool "use ca comsst api"
	default n
	---help---
		"Use ca comsst api"

if CA_COMSST_API

config CA_COMSST_TEST
	bool "client application: comsst test"
	default n
	---help---
		"GP CA: COMSST_TEST."

if CA_COMSST_TEST

config CA_COMSST_TEST_PROGNAME
	string "Program name"
	default "ca_comsst_test"
	---help---
		This is the name of the client application that will be used

config CA_COMSST_TEST_PRIORITY
	int "comsst test task priority"
	default 100

config CA_COMSST_TEST_STACKSIZE
	int "comsst test stack size"
	default 32768

endif
endif
```

## ca/pin/Kconfig
```kconfig
############################################################################
#
# Copyright (C) 2022-2024 Xiaomi Corporation
#
# Licensed under the Apache License, Version 2.0 (the "License");
# you may not use this file except in compliance with the License.
# You may obtain a copy of the License at
#
#      http://www.apache.org/licenses/LICENSE-2.0
#
# Unless required by applicable law or agreed to in writing, software
# distributed under the License is distributed on an "AS IS" BASIS,
# WITHOUT WARRANTIES OR CONDITIONS OF ANY KIND, either express or implied.
# See the License for the specific language governing permissions and
# limitations under the License.
#
############################################################################

config CA_PIN_API
	bool "use ca pin api"
	default n
	---help---
		"Use ca pin api"

if CA_PIN_API

config CA_PIN_TEST
	bool "client application: pin test"
	default n
	---help---
		"GP CA: PIN_TEST."

if CA_PIN_TEST

config CA_PIN_TEST_PROGNAME
	string "Program name"
	default "ca_pin_test"
	---help---
		This is the name of the client application that will be used

config CA_PIN_TEST_PRIORITY
	int "pin test task priority"
	default 100

config CA_PIN_TEST_STACKSIZE
	int "pin test stack size"
	default 32768

endif
endif
```

## ca/triad/Kconfig
```kconfig
############################################################################
#
# Copyright (C) 2022-2024 Xiaomi Corporation
#
# Licensed under the Apache License, Version 2.0 (the "License");
# you may not use this file except in compliance with the License.
# You may obtain a copy of the License at
#
#      http://www.apache.org/licenses/LICENSE-2.0
#
# Unless required by applicable law or agreed to in writing, software
# distributed under the License is distributed on an "AS IS" BASIS,
# WITHOUT WARRANTIES OR CONDITIONS OF ANY KIND, either express or implied.
# See the License for the specific language governing permissions and
# limitations under the License.
#
############################################################################

config CA_TRIAD_API
	bool "use ca triad api"
	default n
	---help---
		"Use ca triad api"

if CA_TRIAD_API

config CA_TRIAD_TEST
	bool "client application: Triad test"
	default n
	---help---
		"GP CA: TRIAD_TEST."

if CA_TRIAD_TEST

config CA_TRIAD_TEST_PROGNAME
	string "Program name"
	default "ca_triad_test"
	---help---
		This is the name of the client application that will be used

config CA_TRIAD_TEST_PRIORITY
	int "Triad test task priority"
	default 100

config CA_TRIAD_TEST_STACKSIZE
	int "Triad test stack size"
	default DEFAULT_TASK_STACKSIZE

endif

config CA_TRIAD_TOOL
	bool "client application: Triad get/load did and key"
	default n
	---help---
		"GP CA: TRIAD_TOOL."

if CA_TRIAD_TOOL
config CA_TRIAD_TOOL_PROGNAME
	string "Program name"
	default "ca_triad_tool"
	---help---
		This is the name of the client application that will be used

config CA_TRIAD_TOOL_PRIORITY
	int "Triad test task priority"
	default 100

config CA_TRIAD_TOOL_STACKSIZE
	int "Triad test stack size"
	default DEFAULT_TASK_STACKSIZE
endif

endif
```

## ca/wxcodepay/Kconfig
```kconfig
############################################################################
#
# Copyright (C) 2022-2024 Xiaomi Corporation
#
# Licensed under the Apache License, Version 2.0 (the "License");
# you may not use this file except in compliance with the License.
# You may obtain a copy of the License at
#
#      http://www.apache.org/licenses/LICENSE-2.0
#
# Unless required by applicable law or agreed to in writing, software
# distributed under the License is distributed on an "AS IS" BASIS,
# WITHOUT WARRANTIES OR CONDITIONS OF ANY KIND, either express or implied.
# See the License for the specific language governing permissions and
# limitations under the License.
#
############################################################################

config CA_WXCODEPAY_API
	bool "use ca wxcodepay api"
	default n
	---help---
		"Use ca wxcodepay api"

if CA_WXCODEPAY_API

config CA_WXCODEPAY_TEST
	bool "client application: wxcodepay test"
	default n
	---help---
		"GP CA: WXCODEPAY_TEST."

if CA_WXCODEPAY_TEST

config CA_WXCODEPAY_TEST_PROGNAME
	string "Program name"
	default "ca_wxcodepay_test"
	---help---
		This is the name of the client application that will be used

config CA_WXCODEPAY_TEST_PRIORITY
	int "wxcodepay test task priority"
	default 100

config CA_WXCODEPAY_TEST_STACKSIZE
	int "wxcodepay test stack size"
	default 32768

endif
endif
```

## tools/set_model/Kconfig
```kconfig
############################################################################
#
# Copyright (C) 2022-2024 Xiaomi Corporation
#
# Licensed under the Apache License, Version 2.0 (the "License");
# you may not use this file except in compliance with the License.
# You may obtain a copy of the License at
#
#      http://www.apache.org/licenses/LICENSE-2.0
#
# Unless required by applicable law or agreed to in writing, software
# distributed under the License is distributed on an "AS IS" BASIS,
# WITHOUT WARRANTIES OR CONDITIONS OF ANY KIND, either express or implied.
# See the License for the specific language governing permissions and
# limitations under the License.
#
############################################################################

config SC_SET_MODEL
	bool "enable set_model security tool"
	default n
	---help---
		This config enable the set_model security tool, which is
		used to get the device infomation (SN, Mac etc..) from the
		stroage device/file system and set to kvdb.

if SC_SET_MODEL

config SC_SET_MODEL_MIIO_PSM_PATH
	string "the data path"
	default "/data/security/"

config SC_SET_MODEL_MIJIA_PRODUCT_NAME
	string "product name"
	default "86v1"

config SC_SET_MODEL_MIJIA_PRODUCT_ID
	string "mijia product id"
	default "9955"

config SC_SET_MODEL_MIJIA_PRODUCT_MODEL
	string "mijia producet model"
	default "xiaomi.controller.86v1"

config SC_SET_MODEL_PRODUCT_XIAOAI_APP_ID
	string "xiaoai application id"
	default "909534731052254208"

config SC_SET_MODEL_PRODUCT_HARDWARE
	string "hardware name"
	default "X4P"

config SC_SET_MODEL_PROGNAME
	string "Program name"
	default "set_model"
	---help---
		This is the name of the set_model that will be used

config SC_SET_MODEL_PRIORITY
	int "set model test task priority"
	default 100

config SC_SET_MODEL_STACKSIZE
	int "set model test stack size"
	default 4096

endif
```
